## G070RB_TestPrj/west.yml
```yaml
manifest:
  remotes:
    - name: tmx37_github
      url-base: git@github.com:tmx37

  projects:

    - name: Drv_HwskywalkerEsc
      remote: tmx37_github
      repo-path: drv_hwskywalker_esc
      revision: develop
      path: G070RB_TestPrj/Drivers/drv_hwskywalker_esc

    - name: Drv_Hmc5883l
      remote: tmx37_github
      repo-path: drv_hmc5883l
      revision: develop
      path: G070RB_TestPrj/Drivers/drv_hmc5883l

    - name: Drv_Mpu60x0
      remote: tmx37_github
      repo-path: drv_mpu60x0
      revision: develop
      path: G070RB_TestPrj/Drivers/drv_mpu60x0

    - name: Drv_Bmp180
      remote: tmx37_github
      repo-path: drv_bmp180
      revision: develop
      path: G070RB_TestPrj/Drivers/drv_bmp180

    - name: GenUtl
      remote: tmx37_github
      repo-path: GenUtl_EmbeddedC
      revision: develop
      path: G070RB_TestPrj/Prj_Apps/GenUtl

 
self: 
  path: G070RB_TestPrj/Drivers
```
